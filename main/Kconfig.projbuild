## main/Kconfig.projbuild
```kconfig
menu "USB-4-Mic"

    config USB4MIC_USB_PHY_ON_HEADER
        bool "USB mic on GPIO header (D-/D+ on GPIO 24/25)"
        default n
        help
            Optional: route a second USB Full-Speed host to GPIO 24/25 on the 40-pin header.
            Default is off — the ReSpeaker 4-mic sits on the J18 hub with the camera and U2D2.

    config USB4MIC_USB_DM_GPIO
        int "USB D- (DM) GPIO"
        default 24
        depends on USB4MIC_USB_PHY_ON_HEADER
        range 0 54

    config USB4MIC_USB_DP_GPIO
        int "USB D+ (DP) GPIO"
        default 25
        depends on USB4MIC_USB_PHY_ON_HEADER
        range 0 54

endmenu
```
